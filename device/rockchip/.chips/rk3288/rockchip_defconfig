## device/rockchip/.chips/rk3308/rockchip_rk3308_audio_rtos_linux.its
```
/* SPDX-License-Identifier: BSD-3-Clause */
/*
 * Copyright (c) 2022 Rockchip Electronics Co., Ltd.
 */

/dts-v1/;
/ {
	description = "FIT source file for rockchip AMP";
	#address-cells = <1>;

	images {
		amp3 {
			description  = "bare-mental-core3";
			data         = /incbin/("cpu3.bin");
			type         = "firmware";
			compression  = "none";
			arch         = "arm";
			cpu          = <0x3>;
			thumb        = <0>;
			hyp          = <0>;
			load         = <0x02e00000>;
			compile {
				size         = <0x00400000>;
				srambase     = <0xfffa0000>;
				sramsize     = <0x00010000>;
				sys          = "rtt";
				rtt_config   = "board/rk3308_audio_v10/amp_rtt-linux_defconfig"
			};
			udelay       = <10000>;
			hash {
				algo = "sha256";
			};
		};
	};

	share {
		shm_base         = <0x03200000>;
		shm_size         = <0x00100000>;
		rpmsg_base       = <0x07c00000>;
		rpmsg_size       = <0x00500000>;
		primary = <0x3>;
	};

	configurations {
		default = "conf";
		conf {
			description = "Rockchip AMP images";
			rollback-index = <0x0>;
			loadables = "amp3";

			signature {
				algo = "sha256,rsa2048";
				padding = "pss";
				key-name-hint = "dev";
				sign-images = "loadables";
			};

			/* - run linux on cpu0
			 * - it is brought up by amp(that run on U-Boot)
			 * - it is boot entry depends on U-Boot
			 */
			linux {
				description  = "linux-os";
				arch         = "arm64";
				cpu          = <0x0>;
				thumb        = <0>;
				hyp          = <0>;
				udelay       = <0>;
			};
		};
	};
};
```

## device/rockchip/.chips/rk3308/rockchip_rk3308_audio_rtos_smp.its
```
/* SPDX-License-Identifier: BSD-3-Clause */
/*
 * Copyright (c) 2023 Rockchip Electronics Co., Ltd.
 */

/dts-v1/;
/ {
	description = "FIT source file for rockchip AMP";
	#address-cells = <1>;

	images {

		amp0 {
			description  = "bare-mental-core0";
			data         = /incbin/("cpu0.bin");
			type         = "firmware";
			compression  = "none";
			arch         = "arm";	 // "arm64" or "arm"
			cpu          = <0x000>;  // mpidr
			thumb        = <0>;      // 0: arm or thumb2; 1: thumb
			hyp          = <0>;      // 0: el1/svc; 1: el2/hyp
			load         = <0x00800000>;
			compile {
				size         = <0x02700000>;
				srambase     = <0xfff88000>;
				sramsize     = <0x00038000>;
				sys          = "rtt";
				rtt_config   = "board/rk3308_audio_v10/smp_defconfig"
			};
			udelay       = <10000>;
			hash {
				algo = "sha256";
			};
		};

	};

	share {
		shm_base         = <0x02f00000>;
		shm_size         = <0x00100000>;
		primary = <0x0>;
	};

	configurations {
		default = "conf";
		conf {
			description = "Rockchip AMP images";
			rollback-index = <0x0>;
			loadables = "amp0";

			signature {
				algo = "sha256,rsa2048";
				padding = "pss";
				key-name-hint = "dev";
				sign-images = "loadables";
			};
		};
	};
};
```

## device/rockchip/.chips/rk3308/rockchip_rk3308_rtos_amp.its
```
/* SPDX-License-Identifier: BSD-3-Clause */
/*
 * Copyright (c) 2022 Rockchip Electronics Co., Ltd.
 */

/dts-v1/;
/ {
	description = "FIT source file for rockchip AMP";
	#address-cells = <1>;

	images {

		amp0 {
			description  = "bare-mental-core0";
			data         = /incbin/("cpu0.bin");
			type         = "firmware";
			compression  = "none";
			arch         = "arm";	 // "arm64" or "arm"
			cpu          = <0x000>;  // mpidr
			thumb        = <0>;      // 0: arm or thumb2; 1: thumb
			hyp          = <0>;      // 0: el1/svc; 1: el2/hyp
			load         = <0x02600000>;
			udelay       = <10000>;
			compile {
				size         = <0x00900000>;
				srambase     = <0xfffb0000>;
				sramsize     = <0x00010000>;
				sys          = "hal";	 // "hal" or "rtt"
			};
			hash {
				algo = "sha256";
			};
		};

		amp1 {
			description  = "bare-mental-core1";
			data         = /incbin/("cpu1.bin");
			type         = "firmware";
			compression  = "none";
			arch         = "arm";
			cpu          = <0x1>;
			thumb        = <0>;
			hyp          = <0>;
			load         = <0x00800000>;
			udelay       = <10000>;
			compile {
				size         = <0x00a00000>;
				srambase     = <0xfff88000>;
				sramsize     = <0x00008000>;
				sys          = "rtt";
				rtt_config   = "board/rk3308_ddr2_v10/amp_rtt-hal_defconfig"
			};
			hash {
				algo = "sha256";
			};
		};

		amp2 {
			description  = "bare-mental-core2";
			data         = /incbin/("cpu2.bin");
			type         = "firmware";
			compression  = "none";
			arch         = "arm";
			cpu          = <0x2>;
			thumb        = <0>;
			hyp          = <0>;
			load         = <0x01200000>;
			udelay       = <10000>;
			compile {
				size         = <0x00a00000>;
				srambase     = <0xfff90000>;
				sramsize     = <0x00010000>;
				sys          = "hal";
			};
			hash {
				algo = "sha256";
			};
		};

		amp3 {
			description  = "bare-mental-core3";
			data         = /incbin/("cpu3.bin");
			type         = "firmware";
			compression  = "none";
			arch         = "arm";
			cpu          = <0x3>;
			thumb        = <0>;
			hyp          = <0>;
			load         = <0x01c00000>;
			udelay       = <10000>;
			compile {
				size         = <0x00a00000>;
				srambase     = <0xfffa0000>;
				sramsize     = <0x00010000>;
				sys          = "hal";
			};
			hash {
				algo = "sha256";
			};
		};
	};

	share {
		shm_base         = <0x02f00000>;
		shm_size         = <0x00100000>;
		primary          = <0x1>;
	};

	configurations {
		default = "conf";
		conf {
			description = "Rockchip AMP images";
			rollback-index = <0x0>;
			loadables = "amp0", "amp1", "amp2", "amp3";

			signature {
				algo = "sha256,rsa2048";
				padding = "pss";
				key-name-hint = "dev";
				sign-images = "loadables";
			};
		};
	};
};
```
