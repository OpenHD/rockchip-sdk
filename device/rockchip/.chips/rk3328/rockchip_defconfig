## device/rockchip/.chips/rk3562/amp_mcu.its
```
/*
 * Copyright (C) 2023 Rockchip Electronics Co., Ltd
 *
 * SPDX-License-Identifier: GPL-2.0
 */

/dts-v1/;
/ {
	description = "Rockchip AMP FIT Image";
	#address-cells = <1>;

	images {
		mcu {
			description  = "mcu";
			data         = /incbin/("./rtt.bin");
			type         = "standalone";	// must be "standalone"
			compression  = "none";
			arch         = "arm";		// "arm64" or "arm", the same as U-Boot state
			load         = <0x08200000>;
			udelay       = <1000000>;
			compile {
				size     = <0x00800000>;
				sys      = "hal";
				core     = "mcu";
			};
			hash {
				algo = "sha256";
			};
		};
	};

	share {
		shm_base         = <0x07800000>;
		shm_size         = <0x00400000>;
		rpmsg_base       = <0x07c00000>;
		rpmsg_size       = <0x00500000>;
	};

	configurations {
		default = "conf";
		conf {
			description = "Rockchip AMP images";
			rollback-index = <0x0>;
			loadables = "mcu";

			signature {
				algo = "sha256,rsa2048";
				padding = "pss";
				key-name-hint = "dev";
				sign-images = "loadables";
			};
		};
	};
};
```
