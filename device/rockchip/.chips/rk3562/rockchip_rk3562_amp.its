## device/rockchip/.chips/rk3562/rockchip_rk3562_amp.its
```
/* SPDX-License-Identifier: BSD-3-Clause */
/*
 * Copyright (c) 2023 Rockchip Electronics Co., Ltd.
 */

/dts-v1/;
/ {
	description = "FIT source file for rockchip AMP";
	#address-cells = <1>;

	images {
		amp3 {
			description  = "bare-mental-core3";
			data         = /incbin/("cpu3.bin");
			type         = "firmware";
			compression  = "none";
			arch         = "arm";
			cpu          = <0x3>;
			thumb        = <0>;
			hyp          = <0>;
			load         = <0x01800000>;
			compile {
				size         = <0x00800000>;
				srambase     = <0xfe480000>;
				sramsize     = <0x00010000>;
				sys          = "hal";    // "hal" or "rtt"
			}
			udelay       = <10000>;
			hash {
				algo = "sha256";
			};
		};
	};

	share {
		shm_base         = <0x07800000>;
		shm_size         = <0x00400000>;
		rpmsg_base       = <0x07C00000>;
		rpmsg_size       = <0x00500000>;
		primary = <0x3>;
	};

	configurations {
		default = "conf";
		conf {
			description = "Rockchip AMP images";
			rollback-index = <0x0>;
			loadables = "amp3";
			signature {
				algo = "sha256,rsa2048";
				padding = "pss";
				key-name-hint = "dev";
				sign-images = "loadables";
			};

			/* - run linux on cpu0
			 * - it is brought up by amp(that run on U-Boot)
			 * - it is boot entry depends on U-Boot
			 */
			linux {
				description  = "linux-os";
				arch         = "arm64";
				cpu          = <0x000>;
				thumb        = <0>;
				hyp          = <0>;
				udelay       = <0>;
				load         = <0x2000000>; // optional
				load_c       = <0x4880000>; // optional
			};
		};
	};
};
```

## device/rockchip/.chips/rk3588/amp_linux.its
```
/* SPDX-License-Identifier: BSD-3-Clause */
/*
 * Copyright (c) 2023 Rockchip Electronics Co., Ltd.
 */

/dts-v1/;
/ {
	description = "FIT source file for rockchip AMP";
	#address-cells = <1>;

	images {
		amp3 {
			description  = "bare-mental-cpu3";
			data         = /incbin/("cpu3.bin");
			type         = "firmware";
			compression  = "none";
			arch         = "arm64";
			thumb        = <0>;
			hyp          = <0>;
			udelay       = <10000>;
			cpu          = <0x300>;
			load         = <0x01800000>;

			compile {
				size         = <0x00800000>;
				srambase     = <0xff000000>;
				sramsize     = <0x00100000>;
				sys          = "rtt";    // "hal" or "rtt"
				core         = "ap";
				rtt_config   = "board/rk3588_evb1/defconfig"
				cc           = "prebuilts/gcc/linux-x86/aarch64/arm-gnu-toolchain-13.2.Rel1-x86_64-aarch64-none-elf/bin"
			};

			hash {
				algo = "sha256";
			};
		};
	};

	ext_memory {
		shm_base        = <0x07800000>;
		shm_size        = <0x00400000>;
		rpmsg_base      = <0x07c00000>;
		rpmsg_size      = <0x00500000>;
	};

	configurations {
		default = "conf";
		conf {
			description = "Rockchip AMP images";
			rollback-index = <0x0>;
			loadables = "amp3";

			signature {
				algo = "sha256,rsa2048";
				padding = "pss";
				key-name-hint = "dev";
				sign-images = "loadables";
			};

			/* - run linux on cpu0
			 * - it is brought up by amp(that run on U-Boot)
			 * - it is boot entry depends on U-Boot
			 */
			linux {
				description  = "linux-os";
				arch         = "arm64";
				cpu          = <0x000>;
				thumb        = <0>;
				hyp          = <0>;
				udelay       = <0>;
				load         = <0x02100000>;
				load_c       = <0x05480000>;
			};
		};
	};
};
```

## device/rockchip/.chips/rk3588/amp_mcu.its
```
/* SPDX-License-Identifier: BSD-3-Clause */
/*
 * Copyright (c) 2023 Rockchip Electronics Co., Ltd.
 */

/dts-v1/;
/ {
	description = "FIT source file for rockchip AMP";
	#address-cells = <1>;

	images {
		mcu {
			description  = "mcu";
			data         = /incbin/("rtt.bin");
			type         = "standalone";
			compression  = "none";
			arch         = "arm";
			udelay       = <10000>;
			load         = <0x07b00000>;
			cpu          = <0>;
			compile {
				size         = <0x00800000>;
				sys          = "rtt";    // "hal" or "rtt"
				core         = "mcu";    // "mcu" or "ap"
			};

			hash {
				algo = "sha256";
			};
		};
	};

	share {
		rpmsg_base      = <0x07c00000>;
		rpmsg_size      = <0x00500000>;
	};

	configurations {
		default = "conf";
		conf {
			description = "Rockchip AMP images";
			rollback-index = <0x0>;
			loadables = "mcu";

			signature {
				algo = "sha256,rsa2048";
				padding = "pss";
				key-name-hint = "dev";
				sign-images = "loadables";
			};

			/* - run linux on cpu0
			 * - it is brought up by amp(that run on U-Boot)
			 * - it is boot entry depends on U-Boot
			 */
			linux {
				description  = "linux-os";
				arch         = "arm64";
				cpu          = <0x000>;
				thumb        = <0>;
				hyp          = <0>;
				udelay       = <0>;
				load         = <0x02000000>;
				load_c       = <0x05480000>;
			};
		};
	};
};
```
