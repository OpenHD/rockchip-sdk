## rtos/bsp/rockchip/rk3568-32/Kconfig
```kconfig
mainmenu "RT-Thread Project Configuration"

config BSP_DIR
    string
    option env="BSP_ROOT"
    default "."

config RTT_DIR
    string
    option env="RTT_ROOT"
    default "../../.."

source "$RTT_DIR/Kconfig"

config BSP_RK3568
    bool
    select ARCH_ARMV8
    select ARCH_ARM_CORTEX_A
    select RT_USING_COMPONENTS_INIT
    select RT_USING_USER_MAIN
    select RT_USING_FPU
    default y

config ARCH_ARMV8
    bool

config RT_USING_FPU
    bool

source "$BSP_DIR/board/Kconfig"
source "$BSP_DIR/driver/Kconfig"
source "$RTT_DIR/third_party/Kconfig"
```

## rtos/bsp/rockchip/rk3568-32/board/Kconfig
```kconfig
menu "RT-Thread board config"

config RT_BOARD_NAME
    string "the board name that you use"
    default "rk3568_evb1"

config RT_RUN_MEM_BASE
    hex "the memory base address you use"
    default 0x12000000
    help
        Set RK3568 MEM BASE.
        At least 4K align.

config RT_RUN_MEM_SIZE
    hex "the memory size you use"
    default 0x02000000
    help
        Set RK3568 MEM SIZE
        At least 16M, default 32M.

source "$BSP_DIR/board/$RT_BOARD_NAME/Kconfig"

endmenu
```

## rtos/bsp/rockchip/rk3568-32/driver/Kconfig
```kconfig
source "$BSP_DIR/../common/drivers/Kconfig"

menu "RT-Thread rockchip RK3568 drivers"

config RT_USING_CACHE_ECC
    bool "Enable Cache ECC"
    default n

menu "Enable CAN"
    config RT_USING_CAN
        bool "Enable CAN"
        default n

    if RT_USING_CAN
    config RT_USING_CAN1
        bool "Enable CAN1"
        default n
    endif
endmenu

config RT_USING_CRU
    bool "Enable CRU"
    default n

menu "Enable GMAC"
    config RT_USING_GMAC
        bool "Enable GMAC"
        select RT_USING_LWIP
        default n

    if RT_USING_GMAC
    config RT_USING_GMAC0
        bool "Enable GMAC0"
        default n
    config RT_USING_GMAC1
        bool "Enable GMAC1"
        default n
    endif
endmenu

menu "Enable UART"
    config RT_USING_UART
        bool "Enable UART"
        default y

    if RT_USING_UART
    config RT_USING_UART2
        bool "Enable UART2"
        default y

    config RT_USING_UART4
        bool "Enable UART4"
        default n
    endif
endmenu

endmenu
```

## rtos/components/system/Kconfig
```kconfig
menu "System"

config RT_USING_LVGL
	bool "LVGL: Light and Versatile Graphics Library"
	default n
	help
	  Enable LVGL.

if RT_USING_LVGL
	source "$RTT_DIR/components/system/lvgl/Kconfig"
	source "$RTT_DIR/components/system/lvgl/Kconfig.rtt"
endif

endmenu
```
